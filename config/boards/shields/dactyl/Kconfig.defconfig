## config/boards/shields/dactyl/Kconfig.defconfig
```kconfig
if SHIELD_DACTYLS_LEFT

config ZMK_KEYBOARD_NAME
    default "Dactyls"

config ZMK_SPLIT_BLE_ROLE_CENTRAL
	default y

endif

if SHIELD_DACTYLS_LEFT || SHIELD_DACTYLS_RIGHT

config ZMK_SPLIT
	default y

endif
```

## config/west.yml
```yaml
manifest:
  remotes:
    - name: zmkfirmware
      url-base: https://github.com/zmkfirmware
    #- name: manna-harbour
      #url-base: https://github.com/manna-harbour
  projects:
    - name: zmk
      remote: zmkfirmware
      revision: main
      #remote: manna-harbour
      #revision: zephyr-3.0
      import: app/west.yml
      
  self:
    path: config
```
