#include "dactyls.dtsi"

&default_transform { // The matrix transform for this board is 5
    col-offset = <5>;
};

&default_kscan {
    col-gpios
        = <&gpio0 22 GPIO_ACTIVE_HIGH>
        , <&gpio1 6  GPIO_ACTIVE_HIGH>
        , <&gpio1 4  GPIO_ACTIVE_HIGH>
        , <&gpio0 11 GPIO_ACTIVE_HIGH>
        , <&gpio0 22 GPIO_ACTIVE_HIGH>
    ;

    row-gpios
        =  <&gpio1 0 (GPIO_ACTIVE_HIGH | GPIO_PULL_DOWN)>
        ,  <&gpio0 22 (GPIO_ACTIVE_HIGH | GPIO_PULL_DOWN)>
        ,  <&gpio0 22 (GPIO_ACTIVE_HIGH | GPIO_PULL_DOWN)>
        ,  <&gpio0 22 (GPIO_ACTIVE_HIGH | GPIO_PULL_DOWN)>
        ,  <&gpio0 22 (GPIO_ACTIVE_HIGH | GPIO_PULL_DOWN)>
    ;
};