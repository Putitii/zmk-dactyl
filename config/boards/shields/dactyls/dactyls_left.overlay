#include "dactyls.dtsi"

&kscan0   {
        col-gpios
            = <&gpio1 6  GPIO_ACTIVE_HIGH>
            , <&gpio1 4 GPIO_ACTIVE_HIGH>
            , <&gpio0 11 GPIO_ACTIVE_HIGH>
            , <&gpio0 9  GPIO_ACTIVE_HIGH>
            , <&gpio0 24 GPIO_ACTIVE_HIGH>
        ;
        
         row-gpios
            =  <&gpio1 0  (GPIO_ACTIVE_HIGH | GPIO_PULL_DOWN)>
            ,  <&gpio0 10 (GPIO_ACTIVE_HIGH | GPIO_PULL_DOWN)>
            ,  <&gpio1 11 (GPIO_ACTIVE_HIGH | GPIO_PULL_DOWN)>
            ,  <&gpio1 13 (GPIO_ACTIVE_HIGH | GPIO_PULL_DOWN)>
            ,  <&gpio1 15 (GPIO_ACTIVE_HIGH | GPIO_PULL_DOWN)>
            ;
};